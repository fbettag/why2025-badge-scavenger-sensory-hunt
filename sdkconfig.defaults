## sdkconfig.defaults
```kconfig
# ESP-IDF Configuration Defaults for WHY2025 Scavenger Hunt

# WiFi Configuration
CONFIG_ESP_WIFI_SOFTAP_SUPPORT=y
CONFIG_ESP_WIFI_NVS_ENABLED=y

# SPI Configuration
CONFIG_SPI_MASTER_ISR_IN_IRAM=y
CONFIG_SPI_SLAVE_ISR_IN_IRAM=y

# I2C Configuration
CONFIG_I2C_MASTER_ISR_IN_IRAM=y

# Logging
CONFIG_LOG_DEFAULT_LEVEL_DEBUG=y
CONFIG_LOG_COLORS=y

# NVS Configuration
CONFIG_NVS_ENCRYPTION=n
CONFIG_NVS_COMPATIBLE_PRE_V4_3=y

# FreeRTOS
CONFIG_FREERTOS_HZ=1000
CONFIG_FREERTOS_UNICORE=n
CONFIG_FREERTOS_CORETIMER_0=y

# Memory
CONFIG_ESP32_PANIC_PRINT_HALT=n
CONFIG_ESP32_PANIC_PRINT_REBOOT=y

# Partition Table
CONFIG_PARTITION_TABLE_SINGLE_APP=y
CONFIG_PARTITION_TABLE_CUSTOM_FILENAME="partitions.csv"

# SD Card Configuration
CONFIG_FATFS_LFN_HEAP=y
CONFIG_FATFS_VFS_FSTAT_BLKSIZE=4096

# SPIFFS Configuration
CONFIG_SPIFFS_CACHE=y
CONFIG_SPIFFS_CACHE_WR=y

# Debug Configuration
CONFIG_ESP32_DEBUG_STUBS_ENABLE=y
CONFIG_ESP_DEBUG_OCDAWARE=y
```
